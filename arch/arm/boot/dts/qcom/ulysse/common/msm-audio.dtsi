&soc {
	int_codec: sound {
		status = "okay";
		/delete-property/ pinctrl-4;
		/delete-property/ pinctrl-5;
		/delete-property/ pinctrl-6;
		/delete-property/ pinctrl-7;
	};

	ext_codec: sound-9335 {
		/delete-property/ qcom,pinctrl-names;
		/delete-property/ pinctrl-names;
		/delete-property/ pinctrl-0;
		/delete-property/ pinctrl-1;
		/delete-property/ pinctrl-2;
		/delete-property/ pinctrl-3;
	};
};
